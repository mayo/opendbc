VERSION ""

NS_ :

BS_:

BU_: XXX

BO_ 670 _POWERTRAIN_Q: 8 XXX
 SG_ ENGINE_RPM_ISH_Q : 7|8@0+ (1,0) [0|255] "" XXX
 SG_ BRAKE_STOPPING_RELATED_Q : 55|1@0+ (1,0) [0|1] "" XXX

BO_ 640 _CHANGES_ON_ACC_KEY_POS_2: 8 XXX

BO_ 734 _CHANGES_ON_ACC_KEY_POS_1: 8 XXX

BO_ 1477 _Q1: 8 XXX
 SG_ E_BRAKE_Q : 2|1@0+ (1,0) [0|1] "" XXX
